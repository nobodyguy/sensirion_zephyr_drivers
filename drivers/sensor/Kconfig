## drivers/sensor/scd30/Kconfig
```kconfig
# Sensirion SCD30 CO2 sensor configuration options

# Copyright (c) 2021 Advanced Climate Systems
# SPDX-License-Identifier: Apache-2.0

config SCD30
	bool "Sensirion SCD30 CO2 Sensor"
	select I2C
	select CRC
	help
	  Enable driver for SCD30 CO2, temperature, and humidity sensor.
```

## drivers/sensor/scd4x/Kconfig
```kconfig
# SCD4x co2, temperature, and humidity sensor configuration options

# Copyright (c) 2022 Stephen Oliver
# SPDX-License-Identifier: Apache-2.0

config SCD4X
	bool "SCD4x CO2/Temperature/Humidity Sensor"
	select I2C
	select CRC
	help
	  Enable driver for SCD4x CO2, temperature, and humidity sensor.
	  
```
